## roles/devstack/conf/local.conf
```bitbake
[[local|localrc]]

DEST=/opt/stack/
LOGDIR=$DEST/logs
LOGFILE=$LOGDIR/stack.sh.log

ADMIN_PASSWORD=secret
DATABASE_PASSWORD=$ADMIN_PASSWORD
RABBIT_PASSWORD=$ADMIN_PASSWORD
SERVICE_PASSWORD=$ADMIN_PASSWORD

HOST_IP={{ groups['devstack'][0] }}
SERVICE_HOST=$HOST_IP

IMAGE_URLS+=",https://cloud-images.ubuntu.com/xenial/current/xenial-server-cloudimg-amd64-disk1.img"
IMAGE_URLS+=",https://cloud-images.ubuntu.com/bionic/current/bionic-server-cloudimg-amd64.img"

{% if enable_heat is defined and enable_heat|bool == True %}
# HEAT
enable_service heat h-api h-api-cfn h-api-cw h-eng
enable_plugin heat https://git.openstack.org/openstack/heat stable/{{ release }}
enable_plugin heat-dashboard https://git.openstack.org/openstack/heat-dashboard stable/{{ release }}
{% endif %}

disable_service n-net
enable_service n-novnc
enable_service q-svc
enable_service q-agt
enable_service q-dhcp
enable_service q-l3
enable_service q-meta
enable_service tempest
enable_service q-lbaas q-vpn q-fwaas

## Neutron options
Q_USE_SECGROUP=True
FLOATING_RANGE={{ floating_range }}
IPV4_ADDRS_SAFE_TO_USE="172.20.14.0/24"
Q_FLOATING_ALLOCATION_POOL=start={{ start_floating }},end={{ end_floating }}
PUBLIC_NETWORK_GATEWAY={{ gateway }}
PUBLIC_INTERFACE={{ public_interface }}

Q_USE_PROVIDERNET_FOR_PUBLIC=True
OVS_PHYSICAL_BRIDGE=br-ex
PUBLIC_BRIDGE=br-ex
OVS_BRIDGE_MAPPINGS=public:br-ex

NOVA_VNC_ENABLED=True
NOVNCPROXY_URL="http://$HOST_IP:6080/vnc_auto.html"
VNCSERVER_LISTEN=$HOST_IP
VNCSERVER_PROXYCLIENT_ADDRESS=$VNCSERVER_LISTEN

VOLUME_BACKING_FILE_SIZE={{ volume_size }}
LIBVIRT_TYPE=kvm
```
